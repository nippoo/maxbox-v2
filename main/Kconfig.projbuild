## main/Kconfig.projbuild
```kconfig
menu "MaxBox"
config ESP_WIFI_SSID
    string "WiFi SSID"
    default "my-wifi-ssid"
    help
    	SSID (network name) to connect to.

config ESP_WIFI_PASSWORD
    string "WiFi Password"
    default "correcthorsebatterystaple"
    help
        WiFi password (WPA or WPA2) to use.

config MAXBOX_API_ROOT
    string "API endpoint root"
    default "http://127.0.0.1/api/v1/"
    help
        API endpoint, with trailing slash e.g. http://127.0.0.1/api/v1/

config MAXBOX_API_SECRET
    string "API secret"
    default "maxb0x_secr3t"
    help
        Secret for API requests

config MAXBOX_FW_VERSION
    string "Firmware version"
    default "1"
    help
        Firmware version to report as API header
endmenu
```

## sdkconfig.defaults
```kconfig
CONFIG_ESPTOOLPY_FLASHSIZE_4MB=y
CONFIG_PARTITION_TABLE_TWO_OTA=y

CONFIG_ESP_WIFI_SSID="mywifi"
CONFIG_ESP_WIFI_PASSWORD="correcthorsebatterystaple"
CONFIG_API_ROOT="https://carshare.example.com/hardware/api/v1/"

CONFIG_LWIP_PPP_SUPPORT=y
CONFIG_LWIP_PPP_NOTIFY_PHASE_SUPPORT=y
CONFIG_LWIP_PPP_PAP_SUPPORT=y
CONFIG_LWIP_TCPIP_TASK_STACK_SIZE=4096
CONFIG_LWIP_PPP_ENABLE_IPV6=n
```
